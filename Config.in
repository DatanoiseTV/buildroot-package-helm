## Config.in
```kconfig
config BR2_PACKAGE_HELM
        bool "Helm"
        depends on BR2_PACKAGE_XORG7
        depends on BR2_INSTALL_LIBSTDCPP
        depends on BR2_USE_MMU
        depends on BR2_TOOLCHAIN_HAS_THREADS
        depends on BR2_PACKAGE_JACK2
        depends on BR2_PACKAGE_MESA3D_GALLIUM_DRIVER_VC4
```
